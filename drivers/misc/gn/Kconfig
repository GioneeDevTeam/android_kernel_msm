## drivers/misc/gn/Kconfig
```kconfig
menu "Gionee specific support"

config GN_Q_BSP_SYNC_MDSS_VSYNC
	bool "GN_Q_BSP_SYNC_MDSS_VSYNC"
	default y

config GN_Q_BSP_CPUFREQ_LIMIT
	bool "GN_Q_BSP_CPUFREQ_LIMIT"
	default y

config GN_Q_BSP_CPUFREQ_SMART_UP
	bool "GN_Q_BSP_CPUFREQ_SMART_UP"
	default y

config GN_Q_BSP_CPUFREQ_STEP_UP
	bool "GN_Q_BSP_CPUFREQ_STEP_UP"
	default y

config GN_Q_BSP_INPUT_EVENT_LIMIT_CPUFREQ
	bool "GN_Q_BSP_INPUT_EVENT_LIMIT_CPUFREQ"
	default y

config GN_Q_BSP_NO_DOWNLOAD_MODE
	bool "GN_Q_BSP_NO_DOWNLOAD_MODE"
	default y

config GN_Q_BSP_LCD_SAMSUNG_S6E8AA0X01_720p_SUPPORT
	bool "GN_Q_BSP_LCD_SAMSUNG_S6E8AA0X01_720p_SUPPORT"
	default y


config GN_CAMERA_SUPPORT
	bool "GN_CAMERA_SUPPORT"
	default y

config GN_CAMERA_24M_MCLOCK_SUPPORT
	bool "GN_CAMERA_24M_MCLOCK_SUPPORT"
	default y

config GN_Q_BSP_SENSOR_ADJUST_LCD_SUPPORT
	bool "GN_Q_BSP_SENSOR_ADJUST_LCD_SUPPORT"
	default y

config GN_Q_BSP_AUDIO_HEADSET_SUPPORT
	bool "GN_Q_BSP_AUDIO_HEADSET_SUPPORT"
	default y

config GN_Q_BSP_PM_POWEROFF_CHG_SUPPORT
	bool "GN_Q_BSP_PM_POWEROFF_CHG_SUPPORT"
	default y

config GN_Q_BSP_PM_CHG_DEBUG_SUPPORT
	bool "GN_Q_BSP_PM_CHG_DEBUG_SUPPORT"
	default y

config GN_Q_BSP_FACTORY_NV_SUPPORT
	bool "GN_Q_BSP_FACTORY_NV_SUPPORT"
	default y

config GN_Q_BSP_AUDIO_ES325_SUPPORT
	bool "GN_Q_BSP_AUDIO_ES325_SUPPORT"
	default y

config GN_Q_BSP_RECORD_PAUSE_SUPPORT
	bool "GN_Q_BSP_RECORD_PAUSE_SUPPORT"
	default y

config GN_Q_BSP_RECOVERY_SUPPORT
	bool "GN_Q_BSP_RECOVERY_SUPPORT"
	default y

config GN_Q_BSP_AUDIO_FM_SUPPORT
	bool "GN_Q_BSP_AUDIO_FM_SUPPORT"
	default y

config GN_Q_BSP_AUDIO_SET_SCHED_PRIO_SUPPORT
	bool "GN_Q_BSP_AUDIO_SET_SCHED_PRIO_SUPPORT"
	default y

config GN_Q_BSP_PM_BMS_BATTERY_DATA_SUPPORT
	bool "GN_Q_BSP_PM_BMS_BATTERY_DATA_SUPPORT"
	default y

config GN_Q_BSP_PM_NON_STANDARD_CHARGER_SUPPORT
	bool "GN_Q_BSP_PM_NON_STANDARD_CHARGER_SUPPORT"
	default y

config GN_Q_BSP_BACKLIGHT_LM3630_SUPPORT
	bool "GN_Q_BSP_BACKLIGHT_LM3630_SUPPORT"
	default y

config GN_Q_BSP_LCD_COMPATIBILITY_SUPPORT
	bool "GN_Q_BSP_LCD_COMPATIBILITY_SUPPORT"
	default y

config GN_Q_BSP_LCD_TRULY_R63417_SUPPORT
	bool "GN_Q_BSP_LCD_TRULY_R63417_SUPPORT"
	default y

config GN_Q_BSP_LCD_JDI_R63417_SUPPORT
	bool "GN_Q_BSP_LCD_JDI_R63417_SUPPORT"
	default y

config GN_Q_BSP_LCD_TIANMA_NT35595_SUPPORT
	bool "GN_Q_BSP_LCD_TIANMA_NT35595_SUPPORT"
	default y

config GN_Q_BSP_AUDIO_SUPPORT
	bool "GN_Q_BSP_AUDIO_SUPPORT"
	default y

config GN_Q_BSP_AUDIO_MMI_TEST_SUPPORT
	bool "GN_Q_BSP_AUDIO_MMI_TEST_SUPPORT"
	default y

config GN_Q_BSP_AUDIO_REMOVE_FASTMIXER_SUPPORT
	bool "GN_Q_BSP_AUDIO_REMOVE_FASTMIXER_SUPPORT"
	default y

config GN_Q_BSP_USB_SUPPORT
	bool "GN_Q_BSP_USB_SUPPORT"
	default y

config GN_Q_BSP_ISA1200_QPNPCLK_SUPPORT
	bool "GN_Q_BSP_ISA1200_QPNPCLK_SUPPORT"
	default y

config GN_Q_BSP_ISA1200_LEVEL_SUPPORT
	bool "GN_Q_BSP_ISA1200_LEVEL_SUPPORT"
	default y

config GN_Q_BSP_PS_CALIB_SUPPORT
	bool "GN_Q_BSP_PS_CALIB_SUPPORT"
	default y

config GN_Q_BSP_PM8941_CHARGER_SUPPORT
	bool "GN_Q_BSP_PM8941_CHARGER_SUPPORT"
	default y

config GN_Q_BSP_CLK_PWRKEY_VIBRATOR_SUPPORT
	bool "GN_Q_BSP_CLK_PWRKEY_VIBRATOR_SUPPORT"
	default y

config GN_Q_BSP_LK_PWRKEY_CHECK_SUPPORT
	bool "GN_Q_BSP_LK_PWRKEY_CHECK_SUPPORT"
	default y

config GN_Q_BSP_LCD_CHARGE_LOGO_SUPPORT
	bool "GN_Q_BSP_LCD_CHARGE_LOGO_SUPPORT"
	default y

config GN_Q_BSP_WIFI_MAC_ADDR_SUPPORT
	bool "GN_Q_BSP_WIFI_MAC_ADDR_SUPPORT"
	default y

config GN_Q_BSP_LCD_RECOVERY_DISPLAY_SUPPORT
	bool "GN_Q_BSP_LCD_RECOVERY_DISPLAY_SUPPORT"
	default y

config GN_Q_BSP_LCD_TIANMA_R63421_SUPPORT
	bool "GN_Q_BSP_LCD_TIANMA_R63421_SUPPORT"
	default y

config GN_CAMERA_FEATURE_SUPPORT
	bool "GN_CAMERA_FEATURE_SUPPORT"
	default y

config GN_SCALADO_FEATURE_SUPPORT
	bool "GN_SCALADO_FEATURE_SUPPORT"
	default y

config GN_CAMERA_FEATURE_PICTURE_FRAME_SUPPORT
	bool "GN_CAMERA_FEATURE_PICTURE_FRAME_SUPPORT"
	default y

config GN_CAMERA_FEATURE_FACE_BEAUTY_SUPPORT
	bool "GN_CAMERA_FEATURE_FACE_BEAUTY_SUPPORT"
	default y

config GN_CAMERA_FEATURE_GESTURE_SHOT_SUPPORT
	bool "GN_CAMERA_FEATURE_GESTURE_SHOT_SUPPORT"
	default y

config GN_CAMERA_FEATURE_GESTURE_DETECTION_SUPPORT
	bool "GN_CAMERA_FEATURE_GESTURE_DETECTION_SUPPORT"
	default y

config GN_CAMERA_FEATURE_LIVE_EFFECT_SUPPORT
	bool "GN_CAMERA_FEATURE_LIVE_EFFECT_SUPPORT"
	default y

config GN_ARCSOFT_FEATURE_SUPPORT
	bool "GN_ARCSOFT_FEATURE_SUPPORT"
	default y

config GN_CRUNCHFISH_FEATURE_SUPPORT
	bool "GN_CRUNCHFISH_FEATURE_SUPPORT"
	default y

config GN_CAMERA_FEATURE_NIGHT_SHOT_SUPPORT
	bool "GN_CAMERA_FEATURE_NIGHT_SHOT_SUPPORT"
	default y

config GN_CAMERA_FEATURE_SCENE_DETECTION_SUPPORT
	bool "GN_CAMERA_FEATURE_SCENE_DETECTION_SUPPORT"
	default y

config GN_Q_BSP_CHARGE_VOLTAGE_SUPPORT
	bool "GN_Q_BSP_CHARGE_VOLTAGE_SUPPORT"
	default y

config GN_Q_BSP_LK_RTC_ALARM_SUPPORT
	bool "GN_Q_BSP_LK_RTC_ALARM_SUPPORT"
	default y

config GN_Q_BSP_KERNEL_RTC_ALARM_SUPPORT
	bool "GN_Q_BSP_KERNEL_RTC_ALARM_SUPPORT"
	default y

config GN_Q_BSP_BATTERY_10K_NTC_SUPPORT
	bool "GN_Q_BSP_BATTERY_10K_NTC_SUPPORT"
	default y

config GN_Q_BSP_BTC_CONFIG_SUPPORT
	bool "GN_Q_BSP_BTC_CONFIG_SUPPORT"
	default y

config GN_Q_BSP_OVP_9P5V_SUPPORT
	bool "GN_Q_BSP_OVP_9P5V_SUPPORT"
	default y

config GN_Q_BSP_DISABLE_WLED_SUPPORT
	bool "GN_Q_BSP_DISABLE_WLED_SUPPORT"
	default y

config GN_Q_BSP_CONFIG_GPIO52_SUPPORT
	bool "GN_Q_BSP_CONFIG_GPIO52_SUPPORT"
	default y

config GN_Q_BSP_LCD_TPS65132_SUPPORT
	bool "GN_Q_BSP_LCD_TPS65132_SUPPORT"
	default y

config GN_Q_BSP_LCD_CABC_CHANGE_SUPPORT
	bool "GN_Q_BSP_LCD_CABC_CHANGE_SUPPORT"
	default y

config GN_3RD_RECOVER_FROM_RAM
	bool "GN_3RD_RECOVER_FROM_RAM"
	default y

config GN_FACTORY_RESET_KEEP_APK
	bool "GN_FACTORY_RESET_KEEP_APK"
	default y

config GN_Q_BSP_CPU_WR_HOTPLUG_DISABLED_SUPPORT
	bool "GN_Q_BSP_CPU_WR_HOTPLUG_DISABLED_SUPPORT"
	default y

config GN_Q_BSP_BAT_OPTIMIZE_LOW_TEMP_FUEL_GAUGE
	bool "GN_Q_BSP_BAT_OPTIMIZE_LOW_TEMP_FUEL_GAUGE"
	default y

config GN_Q_BSP_CHINA_ECC_SUPPORT
	bool "GN_Q_BSP_CHINA_ECC_SUPPORT"
	default y

config GN_Q_BSP_LK_EMERGENCY_DL_MODE_SUPPORT
	bool "GN_Q_BSP_LK_EMERGENCY_DL_MODE_SUPPORT"
	default y

config GN_Q_BSP_PM_BMS_LOG_SUPPORT
	bool "GN_Q_BSP_PM_BMS_LOG_SUPPORT"
	default y

config GN_Q_BSP_OPTIMIZE_SOC_SUPPORT
	bool "GN_Q_BSP_OPTIMIZE_SOC_SUPPORT"
	default y

config GN_Q_BSP_LCD_SPLASH_IMG_LOGO_SUPPORT
	bool "GN_Q_BSP_LCD_SPLASH_IMG_LOGO_SUPPORT"
	default y

config GN_Q_BSP_FASTBOOT_MODE_PROMPT_SUPPORT
	bool "GN_Q_BSP_FASTBOOT_MODE_PROMPT_SUPPORT"
	default y

config GN_Q_BSP_FASTER_SAMPLING_RATE_SUPPORT
	bool "GN_Q_BSP_FASTER_SAMPLING_RATE_SUPPORT"
	default y

config GN_3RD_RECOVER_FROM_RAM
	bool "GN_3RD_RECOVER_FROM_RAM"
	default y

config GN_FACTORY_RESET_KEEP_APK
	bool "GN_FACTORY_RESET_KEEP_APK"
	default y

config VENDOR_GN
	bool "VENDOR_GN"
	default y

endmenu
```
