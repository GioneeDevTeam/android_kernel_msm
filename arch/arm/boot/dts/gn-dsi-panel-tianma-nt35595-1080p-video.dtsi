/* Copyright (c) 2013, The Linux Foundation. All rights reserved.
 *
 * This program is free software; you can redistribute it and/or modify
 * it under the terms of the GNU General Public License version 2 and
 * only version 2 as published by the Free Software Foundation.
 *
 * This program is distributed in the hope that it will be useful,
 * but WITHOUT ANY WARRANTY; without even the implied warranty of
 * MERCHANTABILITY or FITNESS FOR A PARTICULAR PURPOSE.  See the
 * GNU General Public License for more details.
 */

&soc {
	qcom,mdss_dsi_tianma_nt35595_1080p_video {
		compatible = "qcom,mdss-dsi-panel";
		label-tianma = "tianma nt35590 1080p video mode dsi panel";/* modify for lcd compatibility*/
		label-truly = "truly r63417 1080p video mode dsi panel";
		label-jdi = "jdi r63417 1080p video mode dsi panel";
		status = "disable";
		qcom,dsi-ctrl-phandle = <&mdss_dsi0>;
		qcom,enable-gpio = <&msmgpio 58 0>;
		qcom,lcd-adc1 = <&msmgpio 81 0>;  /*add for lcd compatibility*/
		qcom,lcd-adc2 = <&msmgpio 82 0>;
		qcom,rst-gpio = <&pm8941_gpios 19 0>;
		qcom,mdss-pan-res = <1080 1920>;
		qcom,mdss-pan-bpp = <24>;
		qcom,mdss-pan-dest = "display_1";
		qcom,mdss-pan-porch-values-tianma = <200 20 200 100 10 100>; //modify for lcd compatibility
		qcom,mdss-pan-porch-values-truly = <52 12 52 20 10 20>;
		qcom,mdss-pan-porch-values-jdi = <60 22 120 6 2 8>;
		qcom,mdss-pan-underflow-clr = <0xff>;
		qcom,mdss-pan-bl-ctrl = "bl_ctrl_lm3630"; // change for lm3630 backlight
		qcom,mdss-pan-bl-levels = <1 255>;  // change from 4095 to 255 for lm3630 backlight level
		qcom,mdss-pan-dsi-mode = <0>;
		qcom,mdss-pan-dsi-h-pulse-mode = <0>;
		qcom,mdss-pan-dsi-h-power-stop = <0 0 0>;
		qcom,mdss-pan-dsi-bllp-power-stop = <1 1>;
		qcom,mdss-pan-dsi-traffic-mode = <1>;
		qcom,mdss-pan-dsi-dst-format = <3>;
		qcom,mdss-pan-dsi-vc = <0>;
		qcom,mdss-pan-dsi-rgb-swap = <0>;
		qcom,mdss-pan-dsi-data-lanes = <1 1 1 1>; /* 4 lanes */
		qcom,mdss-pan-dsi-dlane-swap = <0>;
		qcom,mdss-pan-dsi-t-clk = <0x29 0x03>;
		qcom,mdss-pan-dsi-stream = <0>;
		qcom,mdss-pan-dsi-mdp-tr = <0x0>;
		qcom,mdss-pan-dsi-dma-tr = <0x04>;
		qcom,mdss-pan-dsi-frame-rate = <60>;
		qcom,mdss-dsi-pan-enable-dynamic-fps;
		qcom,mdss-dsi-pan-fps-update = "dfps_suspend_resume_mode";
		qcom,mdss-pan-clk-rate = <950000000>;
		qcom,mdss-force-clk-hs = <1>;
		qcom,panel-phy-regulatorSettings = [07 09 03 00  /* Regualotor settings */
						    20 00 01];
		qcom,panel-phy-timingSettings = [da 34 24 00 64 68 28 38 2a 03 04 00];
		qcom,panel-phy-strengthCtrl = [ff 06];
		qcom,panel-phy-bistCtrl = [00 00 b1 ff           /* BIST Ctrl settings */
					   00 00];
		qcom,panel-phy-laneConfig = [00 00 00 00 00 00 00 01 97 /* lane0 config */
					     00 00 00 00 05 00 00 01 97 /* lane1 config */
					     00 00 00 00 0a 00 00 01 97 /* lane2 config */
					     00 00 00 00 0f 00 00 01 97 /* lane3 config */
					     00 c0 00 00 00 00 00 01 bb]; /* Clk ln config */
		qcom,panel-on-cmds-tianma = [  29 01 00 00 00 00 02 FF 20
					29 01 00 00 00 00 02 FB	01
					29 01 00 00 00 00 02 FF	21
					29 01 00 00 00 00 02 FB	01
					29 01 00 00 00 00 02 FF	24
					29 01 00 00 00 00 02 FB	01
					29 01 00 00 00 00 02 FF	20
					29 01 00 00 00 00 02 00	01
					29 01 00 00 00 00 02 01	55
					29 01 00 00 00 00 02 02	45
					29 01 00 00 00 00 02 05	A0
					29 01 00 00 00 00 02 06	A8
					29 01 00 00 00 00 02 07	94
					29 01 00 00 00 00 02 08	0C
					29 01 00 00 00 00 02 0B	73
					29 01 00 00 00 00 02 0C	73
					29 01 00 00 00 00 02 0E	3F
					29 01 00 00 00 00 02 0F	24
					29 01 00 00 00 00 02 11	1C
					29 01 00 00 00 00 02 13	03
					29 01 00 00 00 00 02 15	13
					29 01 00 00 00 00 02 16	13
					29 01 00 00 00 00 02 58	82
					29 01 00 00 00 00 02 59	02
					29 01 00 00 00 00 02 5A	02
					29 01 00 00 00 00 02 5B	02
					29 01 00 00 00 00 02 5C	84
					29 01 00 00 00 00 02 5D	00
					29 01 00 00 00 00 02 5E	00
					29 01 00 00 00 00 02 5F	02
					29 01 00 00 00 00 02 6D	22
					29 01 00 00 00 00 02 FF	21
					29 01 00 00 00 00 02 EB	30
					29 01 00 00 00 00 02 EC	17
					29 01 00 00 00 00 02 ED	20
					29 01 00 00 00 00 02 EE	0F
					29 01 00 00 00 00 02 EF	1F
					29 01 00 00 00 00 02 F0	0F
					29 01 00 00 00 00 02 F1	0F
					29 01 00 00 00 00 02 F2	07
					29 01 00 00 00 00 02 FB	01
					29 01 00 00 00 00 02 FF	24
					29 01 00 00 00 00 02 FB	01
					29 01 00 00 00 00 02 00	00
					29 01 00 00 00 00 02 01	00
					29 01 00 00 00 00 02 02	03
					29 01 00 00 00 00 02 03	04
					29 01 00 00 00 00 02 04	00
					29 01 00 00 00 00 02 05	11
					29 01 00 00 00 00 02 06	0C
					29 01 00 00 00 00 02 07	0B
					29 01 00 00 00 00 02 08	01
					29 01 00 00 00 00 02 09	00
					29 01 00 00 00 00 02 0A	18
					29 01 00 00 00 00 02 0B	16
					29 01 00 00 00 00 02 0C	14
					29 01 00 00 00 00 02 0D	17
					29 01 00 00 00 00 02 0E	15
					29 01 00 00 00 00 02 0F	13
					29 01 00 00 00 00 02 10	00
					29 01 00 00 00 00 02 11	00
					29 01 00 00 00 00 02 12	03
					29 01 00 00 00 00 02 13	04
					29 01 00 00 00 00 02 14	00
					29 01 00 00 00 00 02 15	11
					29 01 00 00 00 00 02 16	0C
					29 01 00 00 00 00 02 17	0B
					29 01 00 00 00 00 02 18	01
					29 01 00 00 00 00 02 19	00
					29 01 00 00 00 00 02 1A	18
					29 01 00 00 00 00 02 1B	16
					29 01 00 00 00 00 02 1C	14
					29 01 00 00 00 00 02 1D	17
					29 01 00 00 00 00 02 1E	15
					29 01 00 00 00 00 02 1F	13
					29 01 00 00 00 00 02 20	00
					29 01 00 00 00 00 02 21	02
					29 01 00 00 00 00 02 22	00
					29 01 00 00 00 00 02 23	66
					29 01 00 00 00 00 02 24	76
					29 01 00 00 00 00 02 25	6D
					29 01 00 00 00 00 02 26	66
					29 01 00 00 00 00 02 27	76
					29 01 00 00 00 00 02 29	58
					29 01 00 00 00 00 02 2A	29
					29 01 00 00 00 00 02 2F	02
					29 01 00 00 00 00 02 30	00
					29 01 00 00 00 00 02 31	49
					29 01 00 00 00 00 02 32	23
					29 01 00 00 00 00 02 33	01
					29 01 00 00 00 00 02 34	01
					29 01 00 00 00 00 02 35	73
					29 01 00 00 00 00 02 36	00
					29 01 00 00 00 00 02 37	1D
					29 01 00 00 00 00 02 38	08
					29 01 00 00 00 00 02 39	01
					29 01 00 00 00 00 02 3A	73
					29 01 00 00 00 00 02 5D	23
					29 01 00 00 00 00 02 61	15
					29 01 00 00 00 00 02 65	00
					29 01 00 00 00 00 02 69	04
					29 01 00 00 00 00 02 72	00
					29 01 00 00 00 00 02 74	09
					29 01 00 00 00 00 02 75	19
					29 01 00 00 00 00 02 76	06
					29 01 00 00 00 00 02 77	02
					29 01 00 00 00 00 02 79	00
					29 01 00 00 00 00 02 7A	02
					29 01 00 00 00 00 02 7B	80
					29 01 00 00 00 00 02 7C	D8
					29 01 00 00 00 00 02 7D	50
					29 01 00 00 00 00 02 7E	09
					29 01 00 00 00 00 02 7F	19
					29 01 00 00 00 00 02 81	06
					29 01 00 00 00 00 02 82	02
					29 01 00 00 00 00 02 8A	33
					29 01 00 00 00 00 02 8B	F0
					29 01 00 00 00 00 02 8E	06
					29 01 00 00 00 00 02 8F	06
					29 01 00 00 00 00 02 93	06
					29 01 00 00 00 00 02 94	06
					29 01 00 00 00 00 02 9B	0F
					29 01 00 00 00 00 02 B3	20
					29 01 00 00 00 00 02 B4	0A
					29 01 00 00 00 00 02 B5	55
					29 01 00 00 00 00 02 C5	30
					29 01 00 00 00 00 02 C7	02
					//29 01 00 00 00 00 02 EC	01   
					29 01 00 00 00 00 02 FF	10
					29 01 00 00 00 00 02 FF	E0
					29 01 00 00 00 00 02 46	63
					29 01 00 00 00 00 02 B5	7F
					29 01 00 00 00 00 02 B6	13
					29 01 00 00 00 00 02 B7	74
					29 01 00 00 00 00 02 B8	3D
					29 01 00 00 00 00 02 A2	A0
					29 01 00 00 00 00 02 07	1E
					29 01 00 00 00 00 02 04	92
					29 01 00 00 00 00 02 FB	01
					29 01 00 00 00 00 02 FF	20
					29 01 00 00 00 00 02 FB	01
					29 01 00 00 00 00 02 75	00
					29 01 00 00 00 00 02 76	23
					29 01 00 00 00 00 02 77	00
					29 01 00 00 00 00 02 78	30
					29 01 00 00 00 00 02 79	00
					29 01 00 00 00 00 02 7A	60
					29 01 00 00 00 00 02 7B	00
					29 01 00 00 00 00 02 7C	7E
					29 01 00 00 00 00 02 7D	00
					29 01 00 00 00 00 02 7E	97
					29 01 00 00 00 00 02 7F	00
					29 01 00 00 00 00 02 80	A3
					29 01 00 00 00 00 02 81	00
					29 01 00 00 00 00 02 82	B4
					29 01 00 00 00 00 02 83	00
					29 01 00 00 00 00 02 84	CC
					29 01 00 00 00 00 02 85	00
					29 01 00 00 00 00 02 86	D2
					29 01 00 00 00 00 02 87	01
					29 01 00 00 00 00 02 88	02
					29 01 00 00 00 00 02 89	01
					29 01 00 00 00 00 02 8A	25
					29 01 00 00 00 00 02 8B	01
					29 01 00 00 00 00 02 8C	5E
					29 01 00 00 00 00 02 8D	01
					29 01 00 00 00 00 02 8E	90
					29 01 00 00 00 00 02 8F	01
					29 01 00 00 00 00 02 90	D3
					29 01 00 00 00 00 02 91	02
					29 01 00 00 00 00 02 92	12
					29 01 00 00 00 00 02 93	02
					29 01 00 00 00 00 02 94	13
					29 01 00 00 00 00 02 95	02
					29 01 00 00 00 00 02 96	50
					29 01 00 00 00 00 02 97	02
					29 01 00 00 00 00 02 98	8E
					29 01 00 00 00 00 02 99	02
					29 01 00 00 00 00 02 9A	B1
					29 01 00 00 00 00 02 9B	02
					29 01 00 00 00 00 02 9C	E5
					29 01 00 00 00 00 02 9D	03
					29 01 00 00 00 00 02 9E	25
					29 01 00 00 00 00 02 9F	03
					29 01 00 00 00 00 02 A0	40
					29 01 00 00 00 00 02 A2	03
					29 01 00 00 00 00 02 A3	4D
					29 01 00 00 00 00 02 A4	03
					29 01 00 00 00 00 02 A5	5D
					29 01 00 00 00 00 02 A6	03
					29 01 00 00 00 00 02 A7	70
					29 01 00 00 00 00 02 A9	03
					29 01 00 00 00 00 02 AA	7D
					29 01 00 00 00 00 02 AB	03
					29 01 00 00 00 00 02 AC	93
					29 01 00 00 00 00 02 AD	03
					29 01 00 00 00 00 02 AE	AC
					29 01 00 00 00 00 02 AF	03
					29 01 00 00 00 00 02 B0	CA
					29 01 00 00 00 00 02 B1	03
					29 01 00 00 00 00 02 B2	E3
					29 01 00 00 00 00 02 B3	00
					29 01 00 00 00 00 02 B4	23
					29 01 00 00 00 00 02 B5	00
					29 01 00 00 00 00 02 B6	30
					29 01 00 00 00 00 02 B7	00
					29 01 00 00 00 00 02 B8	60
					29 01 00 00 00 00 02 B9	00
					29 01 00 00 00 00 02 BA	7E
					29 01 00 00 00 00 02 BB	00
					29 01 00 00 00 00 02 BC	97
					29 01 00 00 00 00 02 BD	00
					29 01 00 00 00 00 02 BE	A3
					29 01 00 00 00 00 02 BF	00
					29 01 00 00 00 00 02 C0	B4
					29 01 00 00 00 00 02 C1	00
					29 01 00 00 00 00 02 C2	CC
					29 01 00 00 00 00 02 C3	00
					29 01 00 00 00 00 02 C4	D2
					29 01 00 00 00 00 02 C5	01
					29 01 00 00 00 00 02 C6	02
					29 01 00 00 00 00 02 C7	01
					29 01 00 00 00 00 02 C8	25
					29 01 00 00 00 00 02 C9	01
					29 01 00 00 00 00 02 CA	5E
					29 01 00 00 00 00 02 CB	01
					29 01 00 00 00 00 02 CC	90
					29 01 00 00 00 00 02 CD	01
					29 01 00 00 00 00 02 CE	D3
					29 01 00 00 00 00 02 CF	02
					29 01 00 00 00 00 02 D0	12
					29 01 00 00 00 00 02 D1	02
					29 01 00 00 00 00 02 D2	13
					29 01 00 00 00 00 02 D3	02
					29 01 00 00 00 00 02 D4	50
					29 01 00 00 00 00 02 D5	02
					29 01 00 00 00 00 02 D6	8E
					29 01 00 00 00 00 02 D7	02
					29 01 00 00 00 00 02 D8	B1
					29 01 00 00 00 00 02 D9	02
					29 01 00 00 00 00 02 DA	E5
					29 01 00 00 00 00 02 DB	03
					29 01 00 00 00 00 02 DC	25
					29 01 00 00 00 00 02 DD	03
					29 01 00 00 00 00 02 DE	40
					29 01 00 00 00 00 02 DF	03
					29 01 00 00 00 00 02 E0	4D
					29 01 00 00 00 00 02 E1	03
					29 01 00 00 00 00 02 E2	5D
					29 01 00 00 00 00 02 E3	03
					29 01 00 00 00 00 02 E4	70
					29 01 00 00 00 00 02 E5	03
					29 01 00 00 00 00 02 E6	7D
					29 01 00 00 00 00 02 E7	03
					29 01 00 00 00 00 02 E8	93
					29 01 00 00 00 00 02 E9	03
					29 01 00 00 00 00 02 EA	AC
					29 01 00 00 00 00 02 EB	03
					29 01 00 00 00 00 02 EC	CA
					29 01 00 00 00 00 02 ED	03
					29 01 00 00 00 00 02 EE	E3
					29 01 00 00 00 00 02 EF	00
					29 01 00 00 00 00 02 F0	23
					29 01 00 00 00 00 02 F1	00
					29 01 00 00 00 00 02 F2	30
					29 01 00 00 00 00 02 F3	00
					29 01 00 00 00 00 02 F4	60
					29 01 00 00 00 00 02 F5	00
					29 01 00 00 00 00 02 F6	7E
					29 01 00 00 00 00 02 F7	00
					29 01 00 00 00 00 02 F8	97
					29 01 00 00 00 00 02 F9	00
					29 01 00 00 00 00 02 FA	A3
					29 01 00 00 00 00 02 FF	21
					29 01 00 00 00 00 02 FB	01
					29 01 00 00 00 00 02 00	00
					29 01 00 00 00 00 02 01	B4
					29 01 00 00 00 00 02 02	00
					29 01 00 00 00 00 02 03	CC
					29 01 00 00 00 00 02 04	00
					29 01 00 00 00 00 02 05	D2
					29 01 00 00 00 00 02 06	01
					29 01 00 00 00 00 02 07	02
					29 01 00 00 00 00 02 08	01
					29 01 00 00 00 00 02 09	25
					29 01 00 00 00 00 02 0A	01
					29 01 00 00 00 00 02 0B	5E
					29 01 00 00 00 00 02 0C	01
					29 01 00 00 00 00 02 0D	90
					29 01 00 00 00 00 02 0E	01
					29 01 00 00 00 00 02 0F	D3
					29 01 00 00 00 00 02 10	02
					29 01 00 00 00 00 02 11	12
					29 01 00 00 00 00 02 12	02
					29 01 00 00 00 00 02 13	13
					29 01 00 00 00 00 02 14	02
					29 01 00 00 00 00 02 15	50
					29 01 00 00 00 00 02 16	02
					29 01 00 00 00 00 02 17	8E
					29 01 00 00 00 00 02 18	02
					29 01 00 00 00 00 02 19	B1
					29 01 00 00 00 00 02 1A	02
					29 01 00 00 00 00 02 1B	E5
					29 01 00 00 00 00 02 1C	03
					29 01 00 00 00 00 02 1D	25
					29 01 00 00 00 00 02 1E	03
					29 01 00 00 00 00 02 1F	40
					29 01 00 00 00 00 02 20	03
					29 01 00 00 00 00 02 21	4D
					29 01 00 00 00 00 02 22	03
					29 01 00 00 00 00 02 23	5D
					29 01 00 00 00 00 02 24	03
					29 01 00 00 00 00 02 25	70
					29 01 00 00 00 00 02 26	03
					29 01 00 00 00 00 02 27	7D
					29 01 00 00 00 00 02 28	03
					29 01 00 00 00 00 02 29	93
					29 01 00 00 00 00 02 2A	03
					29 01 00 00 00 00 02 2B	AC
					29 01 00 00 00 00 02 2D	03
					29 01 00 00 00 00 02 2F	CA
					29 01 00 00 00 00 02 30	03
					29 01 00 00 00 00 02 31	E3
					29 01 00 00 00 00 02 32	00
					29 01 00 00 00 00 02 33	23
					29 01 00 00 00 00 02 34	00
					29 01 00 00 00 00 02 35	30
					29 01 00 00 00 00 02 36	00
					29 01 00 00 00 00 02 37	60
					29 01 00 00 00 00 02 38	00
					29 01 00 00 00 00 02 39	7E
					29 01 00 00 00 00 02 3A	00
					29 01 00 00 00 00 02 3B	97
					29 01 00 00 00 00 02 3D	00
					29 01 00 00 00 00 02 3F	A3
					29 01 00 00 00 00 02 40	00
					29 01 00 00 00 00 02 41	B4
					29 01 00 00 00 00 02 42	00
					29 01 00 00 00 00 02 43	CC
					29 01 00 00 00 00 02 44	00
					29 01 00 00 00 00 02 45	D2
					29 01 00 00 00 00 02 46	01
					29 01 00 00 00 00 02 47	02
					29 01 00 00 00 00 02 48	01
					29 01 00 00 00 00 02 49	25
					29 01 00 00 00 00 02 4A	01
					29 01 00 00 00 00 02 4B	5E
					29 01 00 00 00 00 02 4C	01
					29 01 00 00 00 00 02 4D	90
					29 01 00 00 00 00 02 4E	01
					29 01 00 00 00 00 02 4F	D3
					29 01 00 00 00 00 02 50	02
					29 01 00 00 00 00 02 51	12
					29 01 00 00 00 00 02 52	02
					29 01 00 00 00 00 02 53	13
					29 01 00 00 00 00 02 54	02
					29 01 00 00 00 00 02 55	50
					29 01 00 00 00 00 02 56	02
					29 01 00 00 00 00 02 58	8E
					29 01 00 00 00 00 02 59	02
					29 01 00 00 00 00 02 5A	B1
					29 01 00 00 00 00 02 5B	02
					29 01 00 00 00 00 02 5C	E5
					29 01 00 00 00 00 02 5C	E5
					29 01 00 00 00 00 02 5E	25
					29 01 00 00 00 00 02 5F	03
					29 01 00 00 00 00 02 60	40
					29 01 00 00 00 00 02 61	03
					29 01 00 00 00 00 02 62	4D
					29 01 00 00 00 00 02 63	03
					29 01 00 00 00 00 02 64	5D
					29 01 00 00 00 00 02 65	03
					29 01 00 00 00 00 02 66	70
					29 01 00 00 00 00 02 67	03
					29 01 00 00 00 00 02 68	7D
					29 01 00 00 00 00 02 69	03
					29 01 00 00 00 00 02 6A	93
					29 01 00 00 00 00 02 6B	03
					29 01 00 00 00 00 02 6C	AC
					29 01 00 00 00 00 02 6D	03
					29 01 00 00 00 00 02 6E	CA
					29 01 00 00 00 00 02 6F	03
					29 01 00 00 00 00 02 70	E3
					29 01 00 00 00 00 02 71	00
					29 01 00 00 00 00 02 72	23
					29 01 00 00 00 00 02 73	00
					29 01 00 00 00 00 02 74	30
					29 01 00 00 00 00 02 75	00
					29 01 00 00 00 00 02 76	60
					29 01 00 00 00 00 02 77	00
					29 01 00 00 00 00 02 78	7E
					29 01 00 00 00 00 02 79	00
					29 01 00 00 00 00 02 7A	97
					29 01 00 00 00 00 02 7B	00
					29 01 00 00 00 00 02 7C	A3
					29 01 00 00 00 00 02 7D	00
					29 01 00 00 00 00 02 7E	B4
					29 01 00 00 00 00 02 7F	00
					29 01 00 00 00 00 02 80	CC
					29 01 00 00 00 00 02 81	00
					29 01 00 00 00 00 02 82	D2
					29 01 00 00 00 00 02 83	01
					29 01 00 00 00 00 02 84	02
					29 01 00 00 00 00 02 85	01
					29 01 00 00 00 00 02 86	25
					29 01 00 00 00 00 02 87	01
					29 01 00 00 00 00 02 88	5E
					29 01 00 00 00 00 02 89	01
					29 01 00 00 00 00 02 8A	90
					29 01 00 00 00 00 02 8B	01
					29 01 00 00 00 00 02 8C	D3
					29 01 00 00 00 00 02 8D	02
					29 01 00 00 00 00 02 8E	12
					29 01 00 00 00 00 02 8F	02
					29 01 00 00 00 00 02 90	13
					29 01 00 00 00 00 02 91	02
					29 01 00 00 00 00 02 92	50
					29 01 00 00 00 00 02 93	02
					29 01 00 00 00 00 02 94	8E
					29 01 00 00 00 00 02 95	02
					29 01 00 00 00 00 02 96	B1
					29 01 00 00 00 00 02 97	02
					29 01 00 00 00 00 02 98	E5
					29 01 00 00 00 00 02 99	03
					29 01 00 00 00 00 02 9A	25
					29 01 00 00 00 00 02 9B	03
					29 01 00 00 00 00 02 9C	40
					29 01 00 00 00 00 02 9D	03
					29 01 00 00 00 00 02 9E	4D
					29 01 00 00 00 00 02 9F	03
					29 01 00 00 00 00 02 A0	5D
					29 01 00 00 00 00 02 A2	03
					29 01 00 00 00 00 02 A3	70
					29 01 00 00 00 00 02 A4	03
					29 01 00 00 00 00 02 A5	7D
					29 01 00 00 00 00 02 A6	03
					29 01 00 00 00 00 02 A7	93
					29 01 00 00 00 00 02 A9	03
					29 01 00 00 00 00 02 AA	AC
					29 01 00 00 00 00 02 AB	03
					29 01 00 00 00 00 02 AC	CA
					29 01 00 00 00 00 02 AD	03
					29 01 00 00 00 00 02 AE	E3
					29 01 00 00 00 00 02 AF	00
					29 01 00 00 00 00 02 B0	23
					29 01 00 00 00 00 02 B1	00
					29 01 00 00 00 00 02 B2	30
					29 01 00 00 00 00 02 B3	00
					29 01 00 00 00 00 02 B4	60
					29 01 00 00 00 00 02 B5	00
					29 01 00 00 00 00 02 B6	7E
					29 01 00 00 00 00 02 B7	00
					29 01 00 00 00 00 02 B8	97
					29 01 00 00 00 00 02 B9	00
					29 01 00 00 00 00 02 BA	A3
					29 01 00 00 00 00 02 BB	00
					29 01 00 00 00 00 02 BC	B4
					29 01 00 00 00 00 02 BD	00
					29 01 00 00 00 00 02 BE	CC
					29 01 00 00 00 00 02 BF	00
					29 01 00 00 00 00 02 C0	D2
					29 01 00 00 00 00 02 C1	01
					29 01 00 00 00 00 02 C2	02
					29 01 00 00 00 00 02 C3	01
					29 01 00 00 00 00 02 C4	25
					29 01 00 00 00 00 02 C5	01
					29 01 00 00 00 00 02 C6	5E
					29 01 00 00 00 00 02 C7	01
					29 01 00 00 00 00 02 C8	90
					29 01 00 00 00 00 02 C9	01
					29 01 00 00 00 00 02 CA	D3
					29 01 00 00 00 00 02 CB	02
					29 01 00 00 00 00 02 CC	12
					29 01 00 00 00 00 02 CD	02
					29 01 00 00 00 00 02 CE	13
					29 01 00 00 00 00 02 CF	02
					29 01 00 00 00 00 02 D0	50
					29 01 00 00 00 00 02 D1	02
					29 01 00 00 00 00 02 D2	8E
					29 01 00 00 00 00 02 D3	02
					29 01 00 00 00 00 02 D4	B1
					29 01 00 00 00 00 02 D5	02
					29 01 00 00 00 00 02 D6	E5
					29 01 00 00 00 00 02 D7	03
					29 01 00 00 00 00 02 D8	25
					29 01 00 00 00 00 02 D9	03
					29 01 00 00 00 00 02 DA	40
					29 01 00 00 00 00 02 DB	03
					29 01 00 00 00 00 02 DC	4D
					29 01 00 00 00 00 02 DD	03
					29 01 00 00 00 00 02 DE	5D
					29 01 00 00 00 00 02 DF	03
					29 01 00 00 00 00 02 E0	70
					29 01 00 00 00 00 02 E1	03
					29 01 00 00 00 00 02 E2	7D
					29 01 00 00 00 00 02 E3	03
					29 01 00 00 00 00 02 E4	93
					29 01 00 00 00 00 02 E5	03
					29 01 00 00 00 00 02 E6	AC
					29 01 00 00 00 00 02 E7	03
					29 01 00 00 00 00 02 E8	CA
					29 01 00 00 00 00 02 E9	03
					29 01 00 00 00 00 02 EA	E3
					29 01 00 00 00 00 02 FF	23
					29 01 00 00 00 00 02 08	0C
					29 01 00 00 00 00 02 FB	01
					29 01 00 00 00 00 02 FF	10
					29 01 00 00 00 00 02 35	01
					29 01 00 00 00 00 02 51	FF
					29 01 00 00 00 00 02 53	2C
					29 01 00 00 00 00 02 55	01
					29 01 00 00 00 00 02 BB	03
					29 01 00 00 00 00 02 D3	06
					29 01 00 00 05 00 02 D4	06
					05 01 00 00 78 00 02 11	00
					05 01 00 00 78 00 02 29 00];

			qcom,panel-on-cmds-truly = [  	05 01 00 00 C8 00 02 
						11 00   /*c8 = 200ms for r63417*/
					23 01 00 00 00 00 02 
						B0 04
					29 01 00 00 00 00 07 
						B3 14 00 00 00 00 00
					23 01 00 00 00 00 03  
						B6 3A B3  /*23 for genral short write*/
					23 01 00 00 00 00 02 
						C0 00
					29 01 00 00 00 00 23 			
						C1 84 60 10 EB FF 6F CE FF FF 17 12 58 73
						AE 31 20 C6 FF FF 1F F3 FF 5F 10 10 10 10 
						00 62 01 22 22 00 01
					29 01 00 00 00 00 08 
						C2 31 F7 80 06 08 80 00
					29 01 00 00 00 00 17 
						C4 70 00 00 00 00 00 00 00 00
						0C 06 00 00 00 00 00 00 00 00 00 0C 06
					29 01 00 00 00 00 29 
						C6 C8 08 67 08 67 00 00 00 00 00 00 00 00 
						00 00 00 00 16 18 08 C8 08 67 08 67 00 00 
						00 00 00 00 00 00 00 00 00 00 16 18 08
					29 01 00 00 00 00 0A
						CB 31 FC 3F 8C 00 00 00 00 C0
					23 01 00 00 00 00 02 
						CC 0B
					29 01 00 00 00 00 0B
						D0 11 81 BB 19 99 4C 19 19 0C 00
					29 01 00 00 00 00 1A
						D3 1B 33 BB BB B3 33 33 33 01 01 00 A0 D8 
						A0 0d 48 48 44 3B 22 72 07 3D BF 33
					29 01 00 00 00 00 08 
						D5 06 00 00 01 4E 01 4E
					29 01 00 00 00 00 1F 
						C7 00 0A 12 1B 29 37 41 51 37 42 50 60 68 6D 70 00 0A 12
	                  			1B 29 37 41 51 37 42 50 60 68 6D 70
					29 01 00 00 00 00 14 
						C8 00 00 00 00 00 FC 00 00 00 00 00 FC 00 00 00 00 00 FC 00
					29 01 00 00 00 00 08
						CE 00 01 00 C1 00 00 00
					23 01 00 00 00 00 02 
						51 FF
					23 01 00 00 00 00 02 
						53 2C
					29 01 00 00 00 00 02 
						55 01
					05 01 00 00 F8 00 02 
						29 00
					];
		qcom,panel-on-cmds-jdi = [  	
					39 01 00 00 C8 00 05
						2a 00 00 04 37
					39 01 00 00 00 00 05
						2b 00 00 07 7f
					05 01 00 00 78 00 02
						11 00
					29 01 00 00 78 00 02
						b0 04
					29 01 00 00 78 00 02
						b3 1c
					15 01 00 00 20 00 02
						36 00
					15 01 00 00 00 00 02
						3a 77
					15 01 00 00 00 00 02
						35 00
					05 01 00 00 00 00 02
						29 00
					
					];
		qcom,on-cmds-dsi-state = "DSI_LP_MODE";
		qcom,panel-off-cmds = [05 01 00 00 78 00 02 28 00
					05 01 00 00 78 00 02 10 00];
		qcom,off-cmds-dsi-state = "DSI_HS_MODE";
	};
};
