/* Copyright (c) 2013, The Linux Foundation. All rights reserved.
 *
 * This program is free software; you can redistribute it and/or modify
 * it under the terms of the GNU General Public License version 2 and
 * only version 2 as published by the Free Software Foundation.
 *
 * This program is distributed in the hope that it will be useful,
 * but WITHOUT ANY WARRANTY; without even the implied warranty of
 * MERCHANTABILITY or FITNESS FOR A PARTICULAR PURPOSE.  See the
 * GNU General Public License for more details.
 */

&soc {
	qcom,mdss_dsi_tianma_nt35595_1080p_video {
		compatible = "qcom,mdss-dsi-panel";
		label-tianma = "tianma nt35590 1080p cmd mode dsi panel";/* modify for lcd compatibility*/
		label-truly = "truly r63417 1080p cmd mode dsi panel";
		label-jdi = "jdi r63417 1080p cmd mode dsi panel";
		status = "disable";
		qcom,dsi-ctrl-phandle = <&mdss_dsi0>;
		qcom,enable-gpio = <&msmgpio 58 0>;
		qcom,te-gpio = <&msmgpio 12 0>;
		qcom,lcd-adc1 = <&msmgpio 81 0>;  /*add for lcd compatibility*/
		qcom,lcd-adc2 = <&msmgpio 82 0>;
		qcom,rst-gpio = <&pm8941_gpios 19 0>;
		qcom,tps-enable-gpio = <&pm8941_gpios 33 0>;//add for control -5v enable
		qcom,mdss-pan-res = <1080 1920>;
		qcom,mdss-pan-bpp = <24>;
		qcom,mdss-pan-dest = "display_1";
		qcom,mdss-pan-porch-values-tianma = <52 12 52 20 10 20>; //modify for lcd compatibility
		qcom,mdss-pan-porch-values-truly = <52 12 52 20 10 20>;
		qcom,mdss-pan-porch-values-jdi = <52 12 52 20 10 20>;
		qcom,mdss-pan-underflow-clr = <0xff>;
		qcom,mdss-pan-bl-ctrl = "bl_ctrl_lm3630"; // change for lm3630 backlight
		qcom,mdss-pan-bl-levels = <1 255>;  // change from 4095 to 255 for lm3630 backlight level
		qcom,mdss-pan-dsi-mode = <1>;
		qcom,mdss-vsync-enable = <1>;
		qcom,mdss-hw-vsync-mode = <1>;
		qcom,mdss-pan-dsi-h-pulse-mode = <1>;
		qcom,mdss-pan-dsi-h-power-stop = <0 0 0>;
		qcom,mdss-pan-dsi-bllp-power-stop = <1 1>;
		qcom,mdss-pan-dsi-traffic-mode = <2>;
		qcom,mdss-pan-dsi-dst-format = <8>;
		qcom,mdss-pan-dsi-vc = <0>;
		qcom,mdss-pan-dsi-rgb-swap = <0>;
		qcom,mdss-pan-dsi-data-lanes = <1 1 1 1>; /* 4 lanes */
		qcom,mdss-pan-dsi-dlane-swap = <0>;
		qcom,mdss-pan-dsi-t-clk = <0x29 0x03>;
		qcom,mdss-pan-dsi-stream = <0>;
		qcom,mdss-pan-dsi-mdp-tr = <0x0>;
		qcom,mdss-pan-dsi-dma-tr = <0x04>;
		qcom,mdss-pan-dsi-frame-rate = <60>;
		qcom,mdss-dsi-pan-enable-dynamic-fps;
		qcom,mdss-dsi-pan-fps-update = "dfps_suspend_resume_mode";
		qcom,mdss-pan-clk-rate = <950000000>;
		qcom,mdss-force-clk-hs = <0>;
		qcom,panel-phy-regulatorSettings = [07 09 03 00  /* Regualotor settings */
						    20 00 01];
		qcom,panel-phy-timingSettings = [da 34 24 00 64 68 28 38 2a 03 04 00];
		qcom,panel-phy-strengthCtrl = [ff 06];
		qcom,panel-phy-bistCtrl = [00 00 b1 ff           /* BIST Ctrl settings */
					   00 00];
		qcom,panel-phy-laneConfig = [00 00 00 00 00 00 00 01 97 /* lane0 config */
					     00 00 00 00 05 00 00 01 97 /* lane1 config */
					     00 00 00 00 0a 00 00 01 97 /* lane2 config */
					     00 00 00 00 0f 00 00 01 97 /* lane3 config */
					     00 c0 00 00 00 00 00 01 bb]; /* Clk ln config */
		qcom,panel-on-cmds-tianma = [  
					23 01 00 00 00 00 02 
						B0 04
					23 01 00 00 00 00 02 
						d6 01
					15 01 00 00 00 00 02 
						35 00
					15 01 00 00 00 00 02
                                                51 FF
					15 01 00 00 00 00 02
                                                53 24
					15 01 00 00 00 00 02
                                                55 03
					29 01 00 00 00 00 14
                                                C8 01 00 09 f6 ef fc 00 00 05 fc f7 b8 00 00 fc fc fa b8 00
					29 01 00 00 00 00 21 
						ca 01 80 90 a0 a0 a0 a0 a0 0b 32 80 a0 0a 4a 37 a0 55 f8 0c 
						0c 20 10 3f 3f f0 00 10 10 3f 3f 3f 3f 	
					29 01 00 00 00 00 03 
						DD 31 93
					15 01 00 00 00 00 02 
						36 00
					29 01 00 00 00 00 07 
						B3 04 00 00 00 00 00
					05 01 00 00 78 00 02 
						29 00
					05 01 00 00 78 00 02 
						11 00   /*78 = 120ms for r63417*/
					];

			qcom,panel-on-cmds-tianma-reduce-rate = [  	
					15 01 00 00 00 00 02 
					];
			qcom,panel-on-cmds-truly = [  	
					15 01 00 00 00 00 02 
						35 00
					23 01 00 00 00 00 02 
						B0 04
					23 01 00 00 00 00 02 
						d6 01
					29 01 00 00 00 00 07 
						B3 04 00 00 00 00 00
					29 01 00 00 00 00 03
						B6 3A D3
					29 01 00 00 00 00 07
						b8 07 90 1e 10 1e 32 
					29 01 00 00 00 00 07
						b9 07 82 3c 10 3c 87
					29 01 00 00 00 00 07
						ba 07 78 64 10 64 b4
					23 01 00 00 00 00 02
						C0 00 
					29 01 00 00 00 00 23 			
						C1 84 60 10 EB FF 6F CE FF FF 17 12 58 73
						AE 31 20 C6 FF FF 1F F3 FF 5F 10 10 10 10 
						00 62 01 22 22 00 01
					29 01 00 00 00 00 08 
						C2 31 f7 80 08 08 00 00
					29 01 00 00 00 00 17 
						C4 70 00 00 00 00 04 00 00 00
						0C 06 00 00 00 00 00 04 00 00 00 0C 06
					29 01 00 00 00 00 29 
						C6 70 08 67 08 67 00 00 00 00 00 00 00 00 
						00 00 00 00 16 18 08 70 08 67 08 67 00 00 
						00 00 00 00 00 00 00 00 00 00 16 18 08
					29 01 00 00 00 00 0A
						CB 31 FC 3F 8C 00 00 00 00 C0
					23 01 00 00 00 00 02 
						CC 0B
					29 01 00 00 00 00 0B
						D0 11 81 BB 1E 1E 4C 19 19 0C 00
					29 01 00 00 00 00 1A
						D3 1B 33 BB BB B3 33 33 33 00 01 00 A0 D8 
						A0 0D 4e 4e 44 3B 22 72 07 3D BF 11
					29 01 00 00 00 00 08 
						D5 06 00 00 01 48 01 32
					29 01 00 00 00 00 03 
						DD 31 93
					29 01 00 00 00 00 1F 
						c7 01 0f 1b 23 30 3d 45 51 34 3e 4c 5c 64 6c 76
						   01 0f 1b 23 30 3d 45 51 34 3e 4c 5c 64 6c 76
					29 01 00 00 00 00 14 
						C8 01 00 10 f8 00 c0 00 00 00 00 00 e8 00 00 00 00 00 fc 00
					29 01 00 00 00 00 21 
						ca 01 80 90 ff ff ff ff ff 0b 32 80 a0 0a 4a 37 a0 55 f8 0c 
						0c 20 10 3f 3f f0 00 10 10 3f 3f 3f 3f 	
					15 01 00 00 00 00 02 
						51 FF
					15 01 00 00 00 00 02 
						53 24
					15 01 00 00 00 00 02 
						55 03
					05 01 00 00 78 00 02 
						11 00   /*78 = 120ms for r63417*/
					05 01 00 00 14 00 02 
						29 00
					];
			qcom,panel-on-cmds-truly-reduce-rate = [  	
					15 01 00 00 00 00 02 
						35 00
					23 01 00 00 00 00 02 
						B0 04
					23 01 00 00 00 00 02 
						d6 01
					29 01 00 00 00 00 07 
						B3 04 00 00 00 00 00
					29 01 00 00 00 00 03
						B6 3A D3
					29 01 00 00 00 00 07
						b8 07 90 1e 10 1e 32 
					29 01 00 00 00 00 07
						b9 07 82 3c 10 3c 87
					29 01 00 00 00 00 07
						ba 07 78 64 10 64 b4
					23 01 00 00 00 00 02
						C0 00 
					29 01 00 00 00 00 23 			
						C1 84 60 10 EB FF 6F CE FF FF 17 12 58 73
						AE 31 20 C6 FF FF 1F F3 FF 5F 10 10 10 10 
						00 62 01 22 22 00 01
					29 01 00 00 00 00 08 
						C2 31 f7 80 08 08 00 00
					29 01 00 00 00 00 17 
						C4 70 00 00 00 00 04 00 00 00
						0C 06 00 00 00 00 00 04 00 00 00 0C 06
					29 01 00 00 00 00 29 
						C6 a0 08 67 08 67 00 00 00 00 00 00 00 00 
						00 00 00 00 16 18 08 a0 08 67 08 67 00 00 
						00 00 00 00 00 00 00 00 00 00 16 18 08
					29 01 00 00 00 00 0A
						CB 31 FC 3F 8C 00 00 00 00 C0
					23 01 00 00 00 00 02 
						CC 0B
					29 01 00 00 00 00 0B
						D0 11 81 BB 1E 1E 4C 19 19 0C 00
					29 01 00 00 00 00 1A
						D3 1B 33 BB BB B3 33 33 33 00 01 00 A0 D8 
						A0 0D 4E 4E 44 3B 22 72 07 3D BF 11
					29 01 00 00 00 00 08 
						D5 06 00 00 01 51 01 32
					29 01 00 00 00 00 1F 
						c7 01 0f 1b 24 30 3d 45 51 33 3c 49 59 63 6b 76
						   01 0f 1b 24 30 3d 45 51 33 3c 49 59 63 6b 76
					29 01 00 00 00 00 14 
						C8 01 00 00 00 00 a9 00 00 00 00 00 fc 00 00 00 00 00 fc 00
					29 01 00 00 00 00 21 
						ca 01 80 c0 c0 c0 c0 c0 c0 08 20 80 80 0a 4a 37 a0 55 f8 0c 
						0c 20 10 3f 3f 00 00 10 10 3f 3f 3f 3f 	
					15 01 00 00 00 00 02 
						51 FF
					15 01 00 00 00 00 02 
						53 2c
					15 01 00 00 00 00 02 
						55 03
					05 01 00 00 78 00 02 
						11 00   /*78 = 120ms for r63417*/
					05 01 00 00 14 00 02 
						29 00
					];
		qcom,panel-on-cmds-jdi = [  
					23 01 00 00 00 00 02
						b0 04
					23 01 00 00 00 00 02
						d6 01
					29 01 00 00 00 00 1F 
						c7 00 09 10 18 28 38 42 4e 30 39 45 55 5f 69 7f
						   00 09 10 18 28 38 42 4e 30 39 45 55 5f 69 7f
					29 01 00 00 00 00 14 
						C8 01 00 00 07 00 ff 00 00 00 00 08 b0 00 00 00 00 08 d0 00
					29 01 00 00 00 00 21 
						ca 01 80 80 ff ff ff ff ff 08 20 80 a0 0a 4a 37 a0 55 f8 0c 
						0c 20 10 3f 3f f0 00 10 10 3f 3f 3f 3f 	
					29 01 00 00 00 00 1A
						D3 1B 33 BB BB B3 33 33 33 00 01 00 A0 88 
						A0 08 3f 3f 33 3b 37 72 07 3D BF 55
					29 01 00 00 00 00 07
						b8 07 90 1e 10 1e 32 
					29 01 00 00 00 00 07
						b9 07 82 3c 10 3c 87
					29 01 00 00 00 00 07
						ba 07 78 64 10 64 b4
					15 01 00 00 00 00 02 
						51 FF
					15 01 00 00 00 00 02 
						53 24
					15 01 00 00 00 00 02 
						55 03
					39 01 00 00 00 00 05
						2a 00 00 04 37
					39 01 00 00 00 00 05
						2b 00 00 07 7f
					05 01 00 00 78 00 02
						11 00
					15 01 00 00 14 00 02
						36 00
					15 01 00 00 00 00 02
						3a 77
					15 01 00 00 00 00 02
						35 00
					05 01 00 00 14 00 02
						29 00
					];
		qcom,panel-on-cmds-jdi-reduce-rate = [  
					23 01 00 00 00 00 02
						b0 04
					23 01 00 00 00 00 02
						d6 01
					29 01 00 00 00 00 29 
						C6 a0 03 69 2a 63 00 00 00 00 00 00 00 00 
						00 00 00 00 08 15 0a a0 03 69 2a 63 00 00 
						00 00 00 00 00 00 00 00 00 00 08 15 0a   /*a0 = 45HZ*/
					29 01 00 00 00 00 14 
						C8 01 00 00 00 00 fc 00 00 00 00 00 d0 00 00 00 00 00 d0 00
					29 01 00 00 00 00 07
						b8 07 90 1e 10 1e 32 
					29 01 00 00 00 00 07
						b9 07 82 3c 10 3c 87
					29 01 00 00 00 00 07
						ba 07 78 64 10 64 b4
					15 01 00 00 00 00 02 
						51 FF
					15 01 00 00 00 00 02 
						53 2c
					15 01 00 00 00 00 02 
						55 03
					39 01 00 00 00 00 05
						2a 00 00 04 37
					39 01 00 00 00 00 05
						2b 00 00 07 7f
					05 01 00 00 78 00 02
						11 00
					15 01 00 00 14 00 02
						36 00
					15 01 00 00 00 00 02
						3a 77
					15 01 00 00 00 00 02
						35 00
					05 01 00 00 14 00 02
						29 00
					];
		qcom,on-cmds-dsi-state = "DSI_LP_MODE";
		qcom,panel-off-cmds = [
					29 01 00 00 00 00 08
                                                 d5 06 00 00 00 96 00 96
                                        29 01 00 00 14 00 08
                                                 d5 06 00 00 00 96 00 96
					05 01 00 00 78 00 02 
						28 00
					05 01 00 00 78 00 02 
						10 00
					];
		qcom,off-cmds-dsi-state = "DSI_HS_MODE";
	};
};
